## vendor/u-boot-2022.04-2k1000-dp-src/arch/loongarch/mach-loongson/Kconfig
```kconfig
menu "Loongson setup"
choice 
	prompt "Loongson soc family select"
	default SOC_LS2K500
	depends on ARCH_LA_LOONGSON

config SOC_LS2K500
	bool "Support for LS2K500 family SoCs"
	depends on SUPPORTS_CPU_LOONGARCH64
	select LOONGARCH_L1_CACHE_SHIFT_6

config SOC_LS2K1000
	bool "Support for LS2K1000 family SoCs"
	depends on SUPPORTS_CPU_LOONGARCH64
	select LOONGARCH_L1_CACHE_SHIFT_6

endchoice

choice
	prompt "Board select"

config TARGET_LS2K500_EVB
	bool "LS2K500 EVB Board"
	depends on SOC_LS2K500
	help
	  This supports Loongson 2K500 EVB board.

config TARGET_LS2K500_MINI_DP
	bool "LS2K500 MINI_DP Board"
	depends on SOC_LS2K500
	help
	  This supports Loongson 2K500 MINI_DP board.

config TARGET_LS2K500_HUOLONG_MB
	bool "LS_GD 2K500 MB Board"
	depends on SOC_LS2K500
	help
	  This supports Loongson GD 2K500 HuoLong MB board.

config TARGET_LS2K1000_JINLONG_MB
	bool "LS_GD 2K1000 JinLong MB Board"
	depends on SOC_LS2K1000
	help
	  This supports Loongson GD 2k1000 JinLong MB board.

config TARGET_LS2K1000_DP
	bool "LS_GD 2K1000 DP Board"
	depends on SOC_LS2K1000
	help
	  This supports Loongson GD 2k1000 DP board.

endchoice

config SYS_CPU
	default "LA264" if SOC_LS2K500 || SOC_LS2K1000

config SYS_SOC
	default "ls2k500" if SOC_LS2K500
	default "ls2k1000" if SOC_LS2K1000

source "board/loongson/Kconfig"

endmenu
```

## vendor/u-boot-2022.04-2k1000-dp-src/board/loongson/Kconfig
```kconfig
config MACH_LOONGSON
	bool
	default y if ARCH_LA_LOONGSON || ARCH_MIPS_LOONGSON
	select LAST_STAGE_INIT
	select SPL_BOARD_INIT if SPL

config SYS_VENDOR
	default "loongson"

if SOC_LS2K500
config SYS_BOARD
	default "ls2k500"

config SYS_CONFIG_NAME
	default "loongson_2k500_hl" if TARGET_LS2K500_HUOLONG_MB
	default "loongson_2k500_evb" if TARGET_LS2K500_EVB
	default "loongson_2k500_mini_dp" if TARGET_LS2K500_MINI_DP

endif

if SOC_LS2K1000
config SYS_BOARD
	default "ls2k1000"

config SYS_CONFIG_NAME
	default "loongson_2k1000" if TARGET_LS2K1000_JINLONG_MB
	default "loongson_2k1000_dp" if TARGET_LS2K1000_DP

endif

source "board/loongson/common/Kconfig"
```

## vendor/u-boot-2022.04-2k1000-dp-src/configs/loongson_2k1000_dp_defconfig
```kconfig
CONFIG_LOONGARCH=y
CONFIG_SYS_TEXT_BASE=0x900000000ec00000
CONFIG_SYS_MALLOC_LEN=0x1000000
CONFIG_SYS_MALLOC_F_LEN=0x4000
CONFIG_SPL_LIBCOMMON_SUPPORT=y
CONFIG_SPL_LIBGENERIC_SUPPORT=y
CONFIG_NR_DRAM_BANKS=2
CONFIG_ENV_SIZE=0x4000
CONFIG_ENV_OFFSET=0xe6000
CONFIG_ENV_SECT_SIZE=0x1000
CONFIG_DM_GPIO=y
CONFIG_SPL_DM_SPI=y
CONFIG_DEFAULT_DEVICE_TREE="ls2k1000_dp"
CONFIG_SPL_TEXT_BASE=0x9000000090000000
CONFIG_SPL_SERIAL=y
CONFIG_SPL_STACK_R_ADDR=0x9000000002000000
CONFIG_SPL_SIZE_LIMIT=0x40000
CONFIG_SPL_SIZE_LIMIT_PROVIDE_STACK=0x100
CONFIG_SPL=y
CONFIG_SPL_SPI_FLASH_SUPPORT=y
CONFIG_SPL_SPI=y
CONFIG_ARCH_LA_LOONGSON=y
CONFIG_SOC_LS2K1000=y
CONFIG_TARGET_LS2K1000_DP=y
CONFIG_SPL_PAYLOAD="u-boot.img"
CONFIG_AHCI=y
CONFIG_PHYS_64BIT=y
CONFIG_SYS_LOAD_ADDR=0x9000000090000000
CONFIG_STACK_SIZE=0x200000
CONFIG_BOOTDELAY=0
CONFIG_AUTOBOOT_KEYED=y
CONFIG_AUTOBOOT_DELAY_STR="m"
CONFIG_AUTOBOOT_STOP_STR="c"
CONFIG_USE_BOOTARGS=y
CONFIG_BOOTARGS="console=ttyS0,115200 rootfstype=ext4 rw rootwait"
CONFIG_USE_BOOTCOMMAND=y
CONFIG_BOOTCOMMAND="setenv bootargs ${bootargs} root=/dev/sda${syspart} mtdparts=${mtdparts} video=${video}; sf probe;sf read ${fdt_addr} dtb;scsi reset;ext4load scsi 0:${syspart} ${loadaddr} /boot/uImage;bootm "
CONFIG_LOGLEVEL=7
CONFIG_SYS_CONSOLE_OVERWRITE_ROUTINE=y
# CONFIG_SYS_DEVICE_NULLDEV is not set
CONFIG_DISPLAY_BOARDINFO=y
CONFIG_BOARD_EARLY_INIT_F=y
CONFIG_BOARD_EARLY_INIT_R=y
CONFIG_BOARD_LATE_INIT=y
CONFIG_MISC_INIT_R=y
CONFIG_SPL_SIZE_LIMIT_SUBTRACT_GD=y
CONFIG_SPL_SIZE_LIMIT_SUBTRACT_MALLOC=y
CONFIG_SPL_SHOW_ERRORS=y
CONFIG_SPL_SYS_MALLOC_SIMPLE=y
CONFIG_SPL_STACK_R=y
# CONFIG_SPL_BANNER_PRINT is not set
CONFIG_SPL_DISPLAY_PRINT=y
CONFIG_SPL_MTD_SUPPORT=y
CONFIG_SPL_DM_SPI_FLASH=y
CONFIG_SPL_SPI_FLASH_MTD=y
CONFIG_SPL_SPI_LOAD=y
CONFIG_CMD_BOOTMENU=y
CONFIG_CMD_EEPROM=y
CONFIG_SYS_I2C_EEPROM_ADDR_LEN=2
CONFIG_SYS_EEPROM_SIZE=4096
CONFIG_SYS_EEPROM_PAGE_WRITE_BITS=4
CONFIG_SYS_EEPROM_PAGE_WRITE_DELAY_MS=3
CONFIG_CMD_MD5SUM=y
CONFIG_CMD_MTD=y
CONFIG_CMD_POWEROFF=y
CONFIG_CMD_SF_TEST=y
CONFIG_CMD_USB=y
CONFIG_CMD_PING=y
CONFIG_CMD_BMP=y
CONFIG_CMD_EXT2=y
CONFIG_CMD_EXT4=y
CONFIG_CMD_EXT4_WRITE=y
CONFIG_CMD_FAT=y
CONFIG_CMD_FS_GENERIC=y
CONFIG_CMD_MTDPARTS=y
CONFIG_MTDIDS_DEFAULT="nor0=spi0.0"
CONFIG_MTDPARTS_DEFAULT="spi0.0:920k(uboot),32k(uboot_env),8k(bdinfo),64k(dtb)"
CONFIG_ISO_PARTITION=y
CONFIG_PARTITION_UUIDS=y
CONFIG_OF_BOARD=y
CONFIG_OF_SPL_REMOVE_PROPS="interrupt-parent interrupts"
CONFIG_ENV_OVERWRITE=y
CONFIG_ENV_IS_IN_SPI_FLASH=y
CONFIG_ENV_SECT_SIZE_AUTO=y
CONFIG_ENV_SPI_MAX_HZ=30000000
CONFIG_SYS_RELOC_GD_ENV_ADDR=y
CONFIG_VERSION_VARIABLE=y
CONFIG_NET_RANDOM_ETHADDR=y
CONFIG_BOOTP_SERVERIP=y
CONFIG_SPL_DM=y
CONFIG_SPL_OF_TRANSLATE=y
CONFIG_SCSI_AHCI=y
CONFIG_LOONGSON_AHCI=y
CONFIG_BUTTON=y
CONFIG_BUTTON_GPIO=y
CONFIG_DMA=y
CONFIG_LOONGSON_DMA=y
CONFIG_DM_PCA953X=y
CONFIG_LOONGSON_GPIO=y
CONFIG_SYS_I2C_OCORES=y
CONFIG_LED=y
CONFIG_LED_BLINK=y
CONFIG_LED_GPIO=y
CONFIG_MISC=y
CONFIG_I2C_EEPROM=y
CONFIG_SYS_I2C_EEPROM_ADDR=0x57
CONFIG_MTD=y
CONFIG_DM_MTD=y
CONFIG_DM_SPI_FLASH=y
CONFIG_SF_DEFAULT_SPEED=25000000
CONFIG_SPI_FLASH_EON=y
CONFIG_SPI_FLASH_GIGADEVICE=y
CONFIG_SPI_FLASH_WINBOND=y
CONFIG_SPI_FLASH_MTD=y
CONFIG_PHY_MARVELL=y
CONFIG_PHY_REALTEK=y
CONFIG_DM_ETH=y
CONFIG_DM_MDIO=y
CONFIG_DM_ETH_PHY=y
CONFIG_ETH_DESIGNWARE=y
CONFIG_RGMII=y
CONFIG_MII=y
CONFIG_PINCTRL=y
CONFIG_PINCTRL_SINGLE=y
CONFIG_DM_REGULATOR=y
CONFIG_DM_REGULATOR_GPIO=y
CONFIG_RAM=y
CONFIG_SPL_RAM=y
CONFIG_LOONGSON_DDR=y
CONFIG_SCSI=y
CONFIG_DM_SCSI=y
CONFIG_SERIAL_RX_BUFFER=y
CONFIG_SYS_NS16550=y
CONFIG_SPI=y
CONFIG_DM_SPI=y
CONFIG_LOONGSON_SPI=y
CONFIG_SYSINFO=y
CONFIG_SYSINFO_SMBIOS=y
CONFIG_USB=y
CONFIG_USB_EHCI_HCD=y
CONFIG_USB_EHCI_GENERIC=y
CONFIG_USB_OHCI_HCD=y
CONFIG_USB_OHCI_GENERIC=y
CONFIG_USB_DWC2=y
CONFIG_USB_STORAGE=y
CONFIG_USB_KEYBOARD=y
CONFIG_USB_KEYBOARD_FN_KEYS=y
CONFIG_SYS_USB_EVENT_POLL_VIA_CONTROL_EP=y
CONFIG_DM_VIDEO=y
CONFIG_VIDEO_LOGO=y
CONFIG_BACKLIGHT_GPIO=y
CONFIG_SYS_WHITE_ON_BLACK=y
CONFIG_VIDCONSOLE_AS_LCD=y
CONFIG_VIDEO_BRIDGE=y
CONFIG_VIDEO_BRIDGE_LATTICESEMI_SII9022=y
CONFIG_VIDEO_LOONGSON=y
CONFIG_SPLASH_SCREEN=y
CONFIG_SPLASHIMAGE_GUARD=y
CONFIG_SPLASH_SCREEN_ALIGN=y
CONFIG_BMP_16BPP=y
CONFIG_BMP_24BPP=y
CONFIG_BMP_32BPP=y
CONFIG_FAT_WRITE=y
CONFIG_BCH=y
CONFIG_PANIC_HANG=y
CONFIG_LMB=y
```
